## boards/shields/sparkle/Kconfig.defconfig
```kconfig
if SHIELD_SPARKLE_LEFT

# Name must be less than 16 characters long!
config ZMK_KEYBOARD_NAME
    default "Sparkle"

config ZMK_SPLIT_ROLE_CENTRAL
    default y

endif

if SHIELD_SPARKLE_LEFT || SHIELD_SPARKLE_RIGHT

config ZMK_SPLIT
    default y

endif
```

## boards/shields/sparkle/Kconfig.shield
```kconfig
# No whitespace after the comma or in your part name!
config SHIELD_SPARKLE_LEFT
    def_bool $(shields_list_contains,sparkle_left)

# No whitespace after the comma or in your part name!
config SHIELD_SPARKLE_RIGHT
    def_bool $(shields_list_contains,sparkle_right)
```

## config/boards/shields/futaba/Kconfig.defconfig
```kconfig
# 左側のFutabaシールドが指定されている場合の設定
if SHIELD_SPARKLE_LEFT

# ZMK上でこのキーボードの名前として "Futaba Keyboard" を設定
config ZMK_KEYBOARD_NAME
    default "SPARKLE Keyboard"

# 左側をスプリットキーボードの「中央（central）」として動作させる
config ZMK_SPLIT_ROLE_CENTRAL
    default y

endif

# 左側または右側のFutabaシールドが指定されている場合の設定
if SHIELD_SPARKLE_LEFT || SHIELD_SPARKLE_RIGHT

# スプリットキーボード機能（無線左右通信）を有効にする
config ZMK_SPLIT
    default y

endif
```

## config/boards/shields/futaba/Kconfig.shield
```kconfig
# Futaba の左側シールド（futaba_left）がビルド時に指定されていたら true にするシンボル
config SHIELD_SPARKLE_LEFT
    def_bool $(shields_list_contains,sparkle_left)

# Futaba の右側シールド（futaba_right）がビルド時に指定されていたら true にするシンボル
config SHIELD_SPARKLE_RIGHT
    def_bool $(shields_list_contains,sparkle_right)
```

## config/boards/shields/sparkle/Kconfig.shield
```kconfig
# No whitespace after the comma or in your part name!
config SHIELD_SPARKLE_LEFT
    def_bool $(shields_list_contains,sparkle_left)

config SHIELD_SPARKLE_RIGHT
    def_bool $(shields_list_contains,sparkle_right)


# ============================
# Add custom split definitions
# ============================

config ZMK_SPLIT_ROLE_PERIPHERAL
    bool "Set role as BLE peripheral (slave)"
    depends on ZMK_SPLIT
    default n

config ZMK_SPLIT_ROLE_CENTRAL
    bool "Set role as BLE central (master)"
    depends on ZMK_SPLIT
    default n
```

## west.yml
```yaml
manifest:
  version: 0.11.0
  remotes:
    - name: zephyrproject
      url: https://github.com/zephyrproject-rtos/zephyr.git
    - name: zmk
      url: https://github.com/zmkfirmware/zmk.git
  projects:
    - name: zephyr
      remote: zephyrproject
      revision: main
      path: zephyr
    - name: zmk
      remote: zmk
      revision: main
      path: zmk
  self:
    path: .
```
