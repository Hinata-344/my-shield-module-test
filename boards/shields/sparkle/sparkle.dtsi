#include <dt-bindings/zmk/matrix_transform.h>
#include "sparkle-layouts.dtsi"

 / {
    kscan0: kscan0 {
        compatible = "zmk,kscan-gpio-matrix";
        diode-direction = "row2col";  // または "col2row"
        wakeup-source;

        row-gpios = <&gpio0 10 (GPIO_ACTIVE_LOW | GPIO_PULL_UP)>,
                    <&gpio0 11 (GPIO_ACTIVE_LOW | GPIO_PULL_UP)>,
                    <&gpio0 12 (GPIO_ACTIVE_LOW | GPIO_PULL_UP)>;

        col-gpios = <&gpio1 0 (GPIO_ACTIVE_LOW | GPIO_PULL_UP)>,
                    <&gpio1 1 (GPIO_ACTIVE_LOW | GPIO_PULL_UP)>,
                    <&gpio1 2 (GPIO_ACTIVE_LOW | GPIO_PULL_UP)>,
                    <&gpio1 3 (GPIO_ACTIVE_LOW | GPIO_PULL_UP)>,
                    <&gpio1 4 (GPIO_ACTIVE_LOW | GPIO_PULL_UP)>,
                    <&gpio1 5 (GPIO_ACTIVE_LOW | GPIO_PULL_UP)>,
                    <&gpio1 6 (GPIO_ACTIVE_LOW | GPIO_PULL_UP)>;
    };

    chosen {
        zmk,physical-layout = &physical_layout0;
    };

    matrix_transform {
        compatible = "zmk,matrix-transform";
        rows = <3>;
        columns = <14>;

        map = <
            // row 0
            0   1   2   3   4   5   6   7   8   9  10  11  12  13
            // row 1
            14 15 16 17 18 19 20 21 22 23 24 25 26 27
            // row 2
            28 29 30 31 32 33 34 35 36 37 38 39 40 41
        >;
    };
};
