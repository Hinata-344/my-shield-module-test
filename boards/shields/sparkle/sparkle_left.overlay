#include "sparkle.dtsi"  // 共通の.dtsiファイルを読み込み

&kscan0 {
    matrix-transform = <&matrix_transform>;
    compatible = "zmk,kscan-gpio-matrix";
    diode-direction = "row2col";  // 必要に応じて変更
    wakeup-source;

    row-gpios = <&gpio0 10 (GPIO_ACTIVE_LOW | GPIO_PULL_UP)>,
                <&gpio1 13 (GPIO_ACTIVE_LOW | GPIO_PULL_UP)>,
                <&gpio1 15 (GPIO_ACTIVE_LOW | GPIO_PULL_UP)>;

    col-gpios = <&gpio0 2 (GPIO_ACTIVE_LOW | GPIO_PULL_UP)>,
                <&gpio0 3 (GPIO_ACTIVE_LOW | GPIO_PULL_UP)>,
                <&gpio0 28 (GPIO_ACTIVE_LOW | GPIO_PULL_UP)>,
                <&gpio0 29 (GPIO_ACTIVE_LOW | GPIO_PULL_UP)>,
                <&gpio0 4 (GPIO_ACTIVE_LOW | GPIO_PULL_UP)>,
                <&gpio0 5 (GPIO_ACTIVE_LOW | GPIO_PULL_UP)>,
                <&gpio1 11 (GPIO_ACTIVE_LOW | GPIO_PULL_UP)>;
};
/ {
    matrix_transform: matrix_transform {
        compatible = "zmk,matrix-transform";
        rows = <3>;
        columns = <14>;
        map = <
            0 1 2 3 4 5 6 7 8 9 10 11 12 13
            14 15 16 17 18 19 20 21 22 23 24 25 26 27
            28 29 30 31 32 33 34 35 36 37 38 39 40 41
        >;
    };
};
