#include "my_keyboard.dtsi"  // 共通の.dtsiファイルを読み込み

&kscan0 {
    compatible = "zmk,kscan-gpio-matrix";
    diode-direction = "row2col";  // 必要に応じて変更
    wakeup-source;

    row-gpios = <&gpio0 10 (GPIO_ACTIVE_LOW | GPIO_PULL_UP)>,
                <&gpio1 13 (GPIO_ACTIVE_LOW | GPIO_PULL_UP)>,
                <&gpio1 15 (GPIO_ACTIVE_LOW | GPIO_PULL_UP)>;

    col-gpios = <&gpio0 2 (GPIO_ACTIVE_LOW | GPIO_PULL_UP)>,
                <&gpio0 3 (GPIO_ACTIVE_LOW | GPIO_PULL_UP)>,
                <&gpio0 28 (GPIO_ACTIVE_LOW | GPIO_PULL_UP)>,
                <&gpio0 29 (GPIO_ACTIVE_LOW | GPIO_PULL_UP)>,
                <&gpio0 4 (GPIO_ACTIVE_LOW | GPIO_PULL_UP)>,
                <&gpio0 5 (GPIO_ACTIVE_LOW | GPIO_PULL_UP)>,
                <&gpio1 11 (GPIO_ACTIVE_LOW | GPIO_PULL_UP)>;
};
