// Futaba用の共通定義（キーマトリクス、物理レイアウト、エンコーダなど）をインクルード
#include "sparkle.dtsi"

// 既に定義されている kscan0 ノード（GPIOマトリクススキャン）を上書き／拡張
&kscan0 {
    // 列ピンのGPIOを定義（キー列のスキャン対象）
    col-gpios
        = <&xiao_d 3 GPIO_ACTIVE_HIGH>  // 列0：XIAO D4ピン（アクティブHigh）
        , <&xiao_d 4 GPIO_ACTIVE_HIGH>
        , <&xiao_d 5 GPIO_ACTIVE_HIGH>
        , <&xiao_d 6 GPIO_ACTIVE_HIGH>
        , <&xiao_d 7 GPIO_ACTIVE_HIGH>
        , <&xiao_d 8 GPIO_ACTIVE_HIGH>
        , <&xiao_d 9 GPIO_ACTIVE_HIGH>;
};
