// 共通のFutaba設定を読み込む（物理レイアウトやkscan0の基本設定など）
#include "sparkle.dtsi"

// default_transform（キー行列の物理→論理変換ルール）を修正
&default_transform {
    // 列のオフセットを2列分ずらす（論理配列のマッピングを右に2列ずらす）
    col-offset = <7>;
};

// kscan0（キーマトリクススキャン）の列GPIOを上書き（または追記）
&kscan0 {
    col-gpios
        = <&xiao_d 9 GPIO_ACTIVE_HIGH>  // 列0：XIAOのD9ピン
        , <&xiao_d 8 GPIO_ACTIVE_HIGH>
        , <&xiao_d 7 GPIO_ACTIVE_HIGH>
        , <&xiao_d 6 GPIO_ACTIVE_HIGH>
        , <&xiao_d 5 GPIO_ACTIVE_HIGH>
        , <&xiao_d 3 GPIO_ACTIVE_HIGH>
        , <&xiao_d 4 GPIO_ACTIVE_HIGH>
        ;
};
