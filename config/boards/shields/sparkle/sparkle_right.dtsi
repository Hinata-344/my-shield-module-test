#include <dt-bindings/zmk/matrix_transform.h>
#include "sparkle-layouts.dtsi"

 / {
    kscan0: kscan0 {
        compatible = "zmk,kscan-gpio-matrix";
        diode-direction = "row2col";
        wakeup-source;

        row-gpios = <&gpio0 10 (GPIO_ACTIVE_LOW | GPIO_PULL_UP)>,
                    <&gpio0 11 (GPIO_ACTIVE_LOW | GPIO_PULL_UP)>,
                    <&gpio0 12 (GPIO_ACTIVE_LOW | GPIO_PULL_UP)>;

        col-gpios = <&gpio1 6 (GPIO_ACTIVE_LOW | GPIO_PULL_UP)>,
                    <&gpio1 5 (GPIO_ACTIVE_LOW | GPIO_PULL_UP)>,
                    <&gpio1 4 (GPIO_ACTIVE_LOW | GPIO_PULL_UP)>,
                    <&gpio1 3 (GPIO_ACTIVE_LOW | GPIO_PULL_UP)>,
                    <&gpio1 2 (GPIO_ACTIVE_LOW | GPIO_PULL_UP)>,
                    <&gpio1 0 (GPIO_ACTIVE_LOW | GPIO_PULL_UP)>,
                    <&gpio1 1 (GPIO_ACTIVE_LOW | GPIO_PULL_UP)>;
    };

    chosen {
        zmk,physical-layout = &physical_layout0;
    };

    matrix_transform: matrix_transform {
        compatible = "zmk,matrix-transform";
        rows = <3>;
        columns = <7>;

        map = <
            // row 0（indexは左続き）
            7   8   9  10  11  12  13
            // row 1
            21 22 23 24 25 26 27
            // row 2
            35 36 37 38 39 40 41
        >;
    };
};
