#include "sparkle.dtsi"

&matrix_transform {
    col-offset = <7>;
};

&kscan0 {
    compatible = "zmk,kscan-gpio-matrix";
    diode-direction = "row2col";
    wakeup-source;

    row-gpios = <&gpio0 2 (GPIO_ACTIVE_LOW | GPIO_PULL_UP)>,
                <&gpio0 3 (GPIO_ACTIVE_LOW | GPIO_PULL_UP)>,
                <&gpio0 28 (GPIO_ACTIVE_LOW | GPIO_PULL_UP)>;

    col-gpios = <&gpio0 4 (GPIO_ACTIVE_LOW | GPIO_PULL_UP)>,
                <&gpio0 29 (GPIO_ACTIVE_LOW | GPIO_PULL_UP)>,
                <&gpio0 5 (GPIO_ACTIVE_LOW | GPIO_PULL_UP)>,
                <&gpio1 11 (GPIO_ACTIVE_LOW | GPIO_PULL_UP)>,
                <&gpio1 12 (GPIO_ACTIVE_LOW | GPIO_PULL_UP)>,
                <&gpio1 13 (GPIO_ACTIVE_LOW | GPIO_PULL_UP)>,
                <&gpio1 14 (GPIO_ACTIVE_LOW | GPIO_PULL_UP)>;
};
